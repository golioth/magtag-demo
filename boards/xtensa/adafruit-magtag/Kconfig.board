## boards/xtensa/adafruit-magtag/Kconfig.board
```kconfig
# Copyright (c) 2023 Golioth, Inc.
# SPDX-License-Identifier: Apache-2.0

config BOARD_ADAFRUIT_MAGTAG
	bool "Adafruit MagTag board"
	depends on SOC_ESP32S2
```

## boards/xtensa/adafruit-magtag/Kconfig.defconfig
```kconfig
# Copyright (c) 2023 Golioth, Inc.
# SPDX-License-Identifier: Apache-2.0

# Always set CONFIG_BOARD here. This isn't meant to be customized,
# but is set as a "default" due to Kconfig language restrictions.
config BOARD
	default "adafruit_magtag"
	depends on BOARD_ADAFRUIT_MAGTAG

config ENTROPY_GENERATOR
	default y
```

## magtag-common/KConfig
```kconfig
#
# Copyright (C) 2022 Golioth, Inc.
#
# SPDX-License-Identifier: Apache-2.0
#

menuconfig MAGTAG_COMMON
	bool "Common helper code for Golioth MagTag Demo"
	help
	  Build and link common code that is shared across MagTag samples.

if MAGTAG_COMMON

config MAGTAG_ACCELEROMETER
	bool "Handle accelerometer readings"
	help
	  Get accel from DeviceTree and write readings to shared sensor struct

config MAGTAG_BUTTONS
	bool "Process button reads"
	help
	  Configure buttons for interrupts with callbacks

config MAGTAG_EPAPER
	bool "2.9\" grayscale ePaper driver"
	help
	  Hardware driver for ePaper, including text and partial writes

config MAGTAG_WS2812
	bool "ws2812 helper functions"
	help
	  Intialize and update LED color and state

endif # MAGTAG_COMMON
```
